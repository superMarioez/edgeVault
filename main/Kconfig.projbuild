## main/Kconfig.projbuild
```kconfig
menu "EdgeVault Configuration"

    
    config EV_DEVICE_NAME
        string "Device name"
        default "EdgeVault"
        help
            Configure the device name

    config EV_SENSOR_POLL_INTERVAL_MS
        int "Sensor poll interval (ms)"
        default 1000
        range 100 60000
        help
            Configure the intervals at which the system collects the sensors data

    config EV_MODBUS_POLL_INTERVAL_MS
        int "Modbus poll interval (ms)"
        default 5000
        range 500 60000
        help
            Configure the intervals at which the system collects the modbus RTU data

    menu "I2C Bus"
        config EV_I2C_SDA_GPIO
            int "I2C SDA Pin"
            default 8
            range 0 48
            help
                Configure the I2C Serial Data pin which your board exposes

        config EV_I2C_SCL_GPIO
            int "I2C SCL Pin"
            default 9
            range 0 48
            help
                Configure the I2C serial clock pin which your board exposes

        config EV_I2C_FREQ_HZ
            int "I2C Frequency"
            default 100000
            range 10000 400000
            help
                Configure the I2C bus clock frequency in Hz
    endmenu

    menu "Sensor Addresses"
        config EV_LM75A_I2C_ADDR
            hex "LM75A Address"
            default 0x48
            range 0x48 0x4F
            help
                Configure your LM75A temperature sensor I2C slave address if any
        
        config EV_DS3231_I2C_ADDR
            hex "DS3231 Address"
            default 0x68
            range 0x68 0x68
            help
                Configure your DS3231 module I2C slave address if any
    endmenu

    menu "GPIO"

        config EV_STATUS_LED_GPIO
            int "Status LED"
            default 6
            range 0 48
            help
                Default set to GPIO6 (Sensor AD header), which is exposed on this board.

    endmenu

    menu "Battery ADC"

        config EV_BATTERY_ADC_CHANNEL
            int "Adc Channel"
            default 3
            range 0 9
            help
                ADC channel, defaulted to 3, you can change according to your hardware
            

        config EV_BATTERY_DIVIDER_RATIO_X10
            int "Adc Voltage Divider"
            default 10
            range 10 10
            help
                ADC voltage divider value

    endmenu

    menu "PSRAM"

        config EV_DURATION_HOURS
            int "History Chart Duration"
            default 12
            range 1 24
            help
                how long to keep the last configured readings in the buffer

        config EV_HISTORY_INTERVAL_S
            int "History Polling Interval"
            default 5
            range 1 60
            help
                store a reading every X seconds, should be greater than sensor polling interval

    endmenu

    menu "SPI"

        config EV_SPI_MOSI_PIN
            int "Master-Out Slave-In pin"
            default 11
            range 0 48
            help
                pin responsible for transmitting data to selected slave, default is 11 (native IO_MUX pin). Changing this will route via GPIO matrix and limit speed to 40MHz

        config EV_SPI_MISO_PIN
            int "Master-In Slave-Out"
            default 13
            range 0 48
            help
                pin responsible for receiving data on the bus master, default is 13 (native IO_MUX pin). Changing this will route via GPIO matrix and limit speed to 40MHz

        config EV_SPI_SCLK_PIN
            int "SPI Serial Clock Pin"
            default 12
            range 0 48
            help
                spi serial clock pin, default is 12 (native IO_MUX pin). Changing this will route via GPIO matrix and limit speed to 40MHz

        config EV_SPI_MAX_TSFR_SIZE
            int "SPI Maximum Transfer Size"
            default  32768
            range 512 65536
            help
                maximum bytes can be transferred on the spi bus


        config EV_SDSPI_CS
            int "SD Card CS pin"
            default 10
            range 0 48
            help
                sd card chip select pin

    endmenu


endmenu
```
